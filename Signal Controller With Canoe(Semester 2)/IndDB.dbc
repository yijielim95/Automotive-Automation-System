VERSION ""

NS_ :

BS_:

BU_: GWM

BO_ 570 HVAC_6: 8 GWM
 SG_ FrontTSetRightCmd : 40|6@1- (0.5,0) [0|31] "Deg C" Vector__XXX
 SG_ FrontTSetLeftCmd : 32|6@1- (0.5,0) [0|31] "Deg C" Vector__XXX

BO_ 230 BCM_HMI: 8 GWM
 SG_ DirectionIndicationINST_UB : 49|1@1+ (1,0) [0|0] "" Vector__XXX
 SG_ DirectionIndicationINST : 62|2@1+ (1,0) [0|0] "" Vector__XXX

BA_DEF_ SG_  "GenSigSendType" ENUM  "Cyclic","OnWrite","OnWriteWithRepetition","OnChange","OnChangeWithRepetition","IfActive","IfActiveWithRepetition","NoSigSendType";
BA_DEF_ BO_  "GenMsgSendType " ENUM  "Cyclic","not_used","not_used","not_used","not_used","Cyclic","not_used","IfActive","NoMsgSendType";
BA_DEF_  "DBName" STRING ;
BA_DEF_ BO_  "GenMsgCycleTime" INT 2 50000;
BA_DEF_ BO_  "GenMsgDelayTime" INT 1 1000;
BA_DEF_ BO_  "GenMsgNrOfRepetitions" INT 1 999999;
BA_DEF_ BO_  "GenMsgSendType" ENUM  "cyclic","spontaneous","cyclicIfActive","spontaneousWithDelay","cyclicAndSpontaneous","cyclicAndSpontaneousWithDelay","spontaneousWithRepetition","cyclicIfActiveAndSpontaneousWD";
BA_DEF_DEF_  "GenSigSendType" "Cyclic";
BA_DEF_DEF_  "GenMsgSendType " "NoMsgSendType";
BA_DEF_DEF_  "DBName" "";
BA_DEF_DEF_  "GenMsgCycleTime" 100;
BA_DEF_DEF_  "GenMsgDelayTime" 1;
BA_DEF_DEF_  "GenMsgNrOfRepetitions" 1;
BA_DEF_DEF_  "GenMsgSendType" "spontaneous";
BA_ "DBName" "IndDB";
BA_ "GenMsgSendType" BO_ 230 0;
BA_ "GenMsgCycleTime" BO_ 230 200;
